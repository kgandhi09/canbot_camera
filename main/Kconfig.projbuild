## main/Kconfig.projbuild
```kconfig
menu "CANBOT CAMERA Config"

config WIFI_SSID
    string "WiFi SSID"
    default "NETGEAR_EXT"
    help
      Set the WiFi SSID for the CANBOT to connect to.

config WIFI_PASSWORD
    string "WiFi Password"
    default ""
    help
      Set the WiFi password for the CANBOT to connect to the specified SSID.

config UDP_SERVER_IP
    string "UDP Server IP"
    default "192.168.1.100"
    help
      Set the IP address of the UDP server that the CANBOT will communicate with.

config UDP_SERVER_PORT
    int "UDP Server Port"
    default 12345
    help
      Set the port number of the UDP server that the CANBOT will communicate with.

config NETIF_IP
    string "Network Interface IP"
    default "192.168.1.2"
    help
      Set the IP address for the CANBOT's network interface.
config NETIF_NETMASK
    string "Network Interface Netmask"
    default "255.255.255.0"
    help
      Set the netmask for the CANBOT's network interface.
config NETIF_GATEWAY
    string "Network Interface Gateway"
    default "192.168.1.1"
    help
      Set the gateway for the CANBOT's network interface.
endmenu
```
